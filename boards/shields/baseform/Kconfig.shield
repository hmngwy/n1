## boards/shields/baseform/Kconfig.shield
```kconfig
config SHIELD_BASEFORM_TRIO_BASE_CENTRAL
    def_bool $(shields_list_contains,baseform_trio_base_central)

config SHIELD_BASEFORM_TRIO_LEFT_PERIPHERAL
    def_bool $(shields_list_contains,baseform_trio_left_peripheral)

config SHIELD_BASEFORM_DUO_LEFT_CENTRAL
    def_bool $(shields_list_contains,baseform_duo_left_central)

config SHIELD_BASEFORM_ANY_RIGHT_PERIPHERAL
    def_bool $(shields_list_contains,baseform_any_right_peripheral)
```

## boards/shields/n1/Kconfig.defconfig
```kconfig
# -------------------------
# Central (Duo or Trio base)
# -------------------------
if SHIELD_N1_TRIO_BASE_CENTRAL || SHIELD_N1_DUO_LEFT_CENTRAL

config ZMK_KEYBOARD_NAME
    default "n1"

# Point ZMK to the keymap file based on the layout above
config ZMK_KEYMAP
    string
    default "config/$(KEYMAP_LAYOUT)/n1.keymap"

config ZMK_SPLIT_ROLE_CENTRAL
    bool
    default y

# # Allow selecting layout via -DCONFIG_KEYMAP_LAYOUT="qwerty" (default qwerty)
# config KEYMAP_LAYOUT
#     string "Keymap layout"
#     default "qwerty"
# 
# # Raise Zephyr device name limit only for centrals (prevents overflow on long DT paths)
# config DEVICE_MAX_NAME_LEN
#     int
#     default 128

endif # central

# -------------------------
# Split (all participating halves)
# -------------------------
if SHIELD_N1_TRIO_BASE_CENTRAL || SHIELD_N1_TRIO_LEFT_PERIPHERAL || \
   SHIELD_N1_DUO_LEFT_CENTRAL  || SHIELD_N1_ANY_RIGHT_PERIPHERAL

config ZMK_SPLIT
    default y

endif # split

# -------------------------
# Display config (if enabled)
# -------------------------
if ZMK_DISPLAY

config I2C
    default y

config SSD1306
    default y

endif # ZMK_DISPLAY

# -------------------------
# LVGL display params (if enabled)
# -------------------------
if LVGL

config LV_Z_VDB_SIZE
    default 64

config LV_DPI_DEF
    default 148

config LV_Z_BITS_PER_PIXEL
    default 1

choice LV_COLOR_DEPTH
    default LV_COLOR_DEPTH_1
endchoice

endif # LVGL
```

## boards/shields/n1/Kconfig.shield
```kconfig
config SHIELD_N1_TRIO_BASE_CENTRAL
    def_bool $(shields_list_contains,n1_trio_base_central)

config SHIELD_N1_TRIO_LEFT_PERIPHERAL
    def_bool $(shields_list_contains,n1_trio_left_peripheral)

config SHIELD_N1_DUO_LEFT_CENTRAL
    def_bool $(shields_list_contains,n1_duo_left_central)

config SHIELD_N1_ANY_RIGHT_PERIPHERAL
    def_bool $(shields_list_contains,n1_any_right_peripheral)
```

## config/dvorak/west.yml
```yaml
manifest:
  remotes:
    - name: zmkfirmware
      url-base: https://github.com/zmkfirmware
    # Additional modules containing boards/shields/custom code can be listed here as well
    # See https://docs.zephyrproject.org/3.2.0/develop/west/manifest.html#projects
    - name: englmaxi
      url-base: https://github.com/englmaxi
  projects:
    - name: zmk
      remote: zmkfirmware
      revision: main
      import: app/west.yml
    - name: zmk-dongle-display
      remote: englmaxi
      revision: main
  self:
    path: config
```
