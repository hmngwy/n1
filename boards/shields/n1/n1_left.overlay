#include "netrunner.dtsi" // Notice that the main dtsi files are included in the overlay.
/ {
	kscan0: kscan { 
		compatible = "zmk,kscan-gpio-matrix";
		label = "KSCAN";
		diode-direction = "col2row";
		row-gpios
			= 
			<&pro_micro 5 (GPIO_ACTIVE_HIGH | GPIO_PULL_DOWN)>
			,
			<&pro_micro 6 (GPIO_ACTIVE_HIGH | GPIO_PULL_DOWN)>
			, 
			<&pro_micro 7 (GPIO_ACTIVE_HIGH | GPIO_PULL_DOWN)>
			,
			<&pro_micro 8 (GPIO_ACTIVE_HIGH | GPIO_PULL_DOWN)>
			,
			<&pro_micro 9 (GPIO_ACTIVE_HIGH | GPIO_PULL_DOWN)>
			
			;


		col-gpios
			= 
			<&pro_micro 27 (GPIO_ACTIVE_HIGH | GPIO_PULL_DOWN)>
			, 
			<&pro_micro 26 (GPIO_ACTIVE_HIGH | GPIO_PULL_DOWN)>
			, 
			<&pro_micro 22 (GPIO_ACTIVE_HIGH | GPIO_PULL_DOWN)>
			, 
			
			<&pro_micro 20 (GPIO_ACTIVE_HIGH | GPIO_PULL_DOWN)>
			,
			<&pro_micro 23 (gpio_active_high | gpio_pull_down)>
			,
			<&pro_micro 21 (gpio_active_high | gpio_pull_down)>
			;

	};
};
